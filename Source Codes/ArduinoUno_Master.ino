#include <Arduino.h>
#include <Wire.h>
#include <OneWire.h>
#include <DallasTemperature.h>

// Pin configuration
const int turbiditySensor = A2;
const int tempSensor = 2;

// Relay pins
const int relayPin1 = 8;   // Ultrasonic trigger
const int relayPin2 = 9;   // Heater pump 2
const int relayPin3 = 10;
const int relayPin4 = 11;
const int relayPin5 = 12;
const int relayPin6 = 13;

OneWire oneWire(tempSensor);
DallasTemperature tempSensors(&oneWire);

int samples = 10;
int turbidity;
float tempCelsius;

void setup() {
  Wire.begin();               // Join I2C bus as master
  Serial.begin(9600);
  tempSensors.begin();

  // Initialize relay pins as output
  pinMode(relayPin1, OUTPUT);
  pinMode(relayPin2, OUTPUT);
  pinMode(relayPin3, OUTPUT);
  pinMode(relayPin4, OUTPUT);
  pinMode(relayPin5, OUTPUT);
  pinMode(relayPin6, OUTPUT);

  // Default all relays to OFF (HIGH for low-level trigger relays)
  digitalWrite(relayPin1, HIGH);
  digitalWrite(relayPin2, HIGH);
  digitalWrite(relayPin3, HIGH);
  digitalWrite(relayPin4, HIGH);
  digitalWrite(relayPin5, HIGH);
  digitalWrite(relayPin6, HIGH);
}

float ph(float voltage) {
  return (3.5 * voltage);
}

void loop() {
  int totalReadings = 0;

  for (int i = 0; i < samples; i++) {
    totalReadings += analogRead(turbiditySensor);
    delay(10);
  }

  float voltage = (5.0 / 1024.0) * (totalReadings / samples);
  float acidity = ph(voltage);
  int sensorValue = analogRead(turbiditySensor);
  turbidity = map(sensorValue, 0, 648, 10, 0);

  tempSensors.requestTemperatures(); // Get temperature
  tempCelsius = tempSensors.getTempCByIndex(0);

  // Send sensor data via I2C (to ESP32 slave for example)
  byte byteAcidity = (byte)acidity;
  byte byteTurbidity = (byte)turbidity;
  byte byteTemp = (byte)tempCelsius;

  Wire.beginTransmission(8);     // Address of ESP32 (slave)
  Wire.write(byteAcidity);       // Send pH
  Wire.write(byteTurbidity);     // Send turbidity
  Wire.write(byteTemp);          // Send temperature
  Wire.endTransmission();

  // Debug output
  Serial.print("pH: ");
  Serial.println(acidity);
  Serial.print("Turbidity: ");
  Serial.println(turbidity);
  Serial.print("Temperature: ");
  Serial.println(tempCelsius);

  // Relay logic based on thresholds
  if (acidity > 8.3) {
    digitalWrite(relayPin2, LOW);  // Turn on heater pump
  } else {
    digitalWrite(relayPin2, HIGH); // Turn off heater pump
  }

  if (turbidity > 25) {
    digitalWrite(relayPin3, LOW);  // Turn on turbidity pump
    digitalWrite(relayPin6, LOW);
  } else {
    digitalWrite(relayPin3, HIGH); // Turn off turbidity pump
    digitalWrite(relayPin6, HIGH);
  }

  if (tempCelsius > 30) {
    digitalWrite(relayPin4, LOW);  // Turn on fan
  } else {
    digitalWrite(relayPin4, HIGH); // Turn off fan
  }

  delay(500);
}
