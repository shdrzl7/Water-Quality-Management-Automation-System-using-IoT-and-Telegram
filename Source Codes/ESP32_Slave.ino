#include <Wire.h>
#include <WiFi.h>
#include <UniversalTelegramBot.h>
#include <WiFiClientSecure.h>

// I2C address of ESP32 slave
#define I2C_SLAVE_ADDR 0x28

// WiFi credentials
const char* ssid = "Totoro_2.4G";
const char* password = "ntkesatul";

// Telegram bot credentials
const char* telegramBotToken = "248161904:AAGhAREEONIhjY127d"; // (example only)
const int telegramChatID = 1687226895;

WiFiClientSecure client;
UniversalTelegramBot bot(telegramBotToken, client);

// Sensor data
float acidity;
int turbidity;
float tempCelsius;

// Function declarations
void receiveEvent(int bytes);
void sendTelegramAlert(String alertMessage);
void handleTelegramMessages(int numNewMessages);

void setup() {
  Serial.begin(9600);

  // Connect to WiFi
  WiFi.begin(ssid, password);
  while (WiFi.status() != WL_CONNECTED) {
    delay(1000);
    Serial.println("Connecting to WiFi...");
  }

  Serial.println("Connected to WiFi");
  Serial.print("Local IP: ");
  Serial.println(WiFi.localIP());

  // Setup I2C as slave
  Wire.begin(I2C_SLAVE_ADDR);
  Wire.onReceive(receiveEvent);

  // Telegram SSL Certificate
  client.setCACert(TELEGRAM_CERTIFICATE_ROOT);
}

void loop() {
  int numNewMessages = bot.getUpdates(bot.last_message_received + 1);
  while (numNewMessages) {
    Serial.println("New Telegram message received");
    handleTelegramMessages(numNewMessages);
    numNewMessages = bot.getUpdates(bot.last_message_received + 1);
  }

  // Check conditions and send alerts if needed
  if (acidity < 7.5) {
    sendTelegramAlert("⚠️ Water is too ACIDIC! Turning on alkaline pump.");
  } else if (acidity > 8.5) {
    sendTelegramAlert("⚠️ Water is too ALKALINE! Turning on acidic pump.");
  }

  if (turbidity > 25) {
    sendTelegramAlert("⚠️ Water is not CLEAR! Initiating water exchange.");
  }

  if (tempCelsius < 28) {
    sendTelegramAlert("⚠️ Water is too COLD! Turning on heater.");
  } else if (tempCelsius > 38) {
    sendTelegramAlert("⚠️ Water is too HOT! Turning on cooling fan.");
  }

  delay(5000); // delay between checks
}

void receiveEvent(int bytes) {
  if (Wire.available() >= 3) {
    acidity = Wire.read();          // 1 byte
    turbidity = Wire.read();        // 1 byte
    tempCelsius = Wire.read();      // 1 byte

    Serial.print("Received pH: ");
    Serial.println(acidity);
    Serial.print("Received Turbidity: ");
    Serial.println(turbidity);
    Serial.print("Received Temperature: ");
    Serial.println(tempCelsius);
  } else {
    Serial.println("⚠️ Insufficient I2C data received.");
    Serial.print("Bytes available: ");
    Serial.println(Wire.available());
  }
}

void handleTelegramMessages(int numNewMessages) {
  for (int i = 0; i < numNewMessages; i++) {
    String text = bot.messages[i].text;
    long chat_id = bot.messages[i].chat_id;

    if (text == "/start") {
      String welcome = "👋 Welcome to Water Quality Monitoring System by Shad Rizal\n\n";
      welcome += "/status - View current water parameters\n";
      welcome += "/alkalinePump_ON - Turn ON alkaline pump\n";
      welcome += "/alkalinePump_OFF - Turn OFF alkaline pump\n";
      welcome += "/acidicPump_ON - Turn ON acidic pump\n";
      welcome += "/acidicPump_OFF - Turn OFF acidic pump\n";
      welcome += "/externalPump_ON - Turn ON external tank pump\n";
      welcome += "/externalPump_OFF - Turn OFF external tank pump\n";
      welcome += "/tankPump_ON - Remove water from tank\n";
      welcome += "/tankPump_OFF - Stop water removal\n";
      welcome += "/fan_ON - Turn ON cooling fan\n";
      welcome += "/fan_OFF - Turn OFF cooling fan\n";
      welcome += "/heater_ON - Turn ON heater\n";
      welcome += "/heater_OFF - Turn OFF heater\n";
      welcome += "/feeder_ON - Turn ON feeder";

      bot.sendMessage(String(chat_id), welcome, "Markdown");
    } else if (text == "/status") {
      String status = "📊 Water Parameters:\n";
      status += "pH Level: " + String(acidity) + "\n";
      status += "Turbidity: " + String(turbidity) + " NTU\n";
      status += "Temperature: " + String(tempCelsius) + " °C";

      bool sent = bot.sendMessage(String(chat_id), status, "Markdown");
      if (sent) {
        Serial.println("✅ Status sent to Telegram");
      } else {
        Serial.println("❌ Failed to send status to Telegram");
      }
    }
  }
}

void sendTelegramAlert(String alertMessage) {
  bool sent = bot.sendMessage(String(telegramChatID), alertMessage, "Markdown");
  if (sent) {
    Serial.println("🚨 Alert sent to Telegram");
  } else {
    Serial.println("❌ Failed to send alert to Telegram");
  }
}
